## sdkconfig.defaults
```kconfig
CONFIG_FREERTOS_HZ=1000
# Bump Tmr Svc task stack: BLE timer callbacks (advertising watchdog, pairing
# timeout, conn-param tuner) call into NimBLE which can easily overrun 2 KB.
CONFIG_FREERTOS_TIMER_TASK_STACK_DEPTH=4096
CONFIG_AUTOSTART_ARDUINO=y
CONFIG_ESPTOOLPY_FLASHSIZE_8MB=y
CONFIG_ESPTOOLPY_FLASHMODE_QIO=y
CONFIG_ESPTOOLPY_FLASHFREQ_80M=y
CONFIG_ESP32S3_DEFAULT_CPU_FREQ_240=y
CONFIG_BT_ENABLED=y
CONFIG_BT_CONTROLLER_ENABLED=y
CONFIG_BT_BLUEDROID_ENABLED=y
# CONFIG_BT_NIMBLE_ENABLED is not set
CONFIG_COMPILER_CXX_EXCEPTIONS=y
# App rollback: the bootloader marks the first boot after an OTA as
# PENDING_VERIFY; the app must call esp_ota_mark_app_valid_cancel_rollback()
# (end of setup() in main.cpp) or the next reset reverts to the previous
# slot. Turns a hash-valid-but-crashing OTA image into an automatic recovery
# instead of a field brick. Ships with the (last) USB flash wave — the
# bootloader half can never be delivered over OTA.
CONFIG_BOOTLOADER_APP_ROLLBACK_ENABLE=y
# Reboot (not just warn) if the watchdog-fed control loop stalls. The firmware
# already does this via a runtime esp_task_wdt_init(.., panic=true) call; setting
# it here makes the safety baseline hold even if that runtime call is ever moved.
CONFIG_ESP_TASK_WDT_PANIC=y
# Capture an ELF core dump to the (already-reserved) coredump flash partition on
# panic/WDT reset. diagnostics.cpp already has the reader; this populates it so a
# field crash backtrace can be pulled over USB (espcoredump.py) during testing.
CONFIG_ESP_COREDUMP_ENABLE_TO_FLASH=y
CONFIG_ESP_COREDUMP_DATA_FORMAT_ELF=y
```
